#include <7080S.H>
#include "libmemes.h"

#define printf ((int (*)(const char *, ...))0x00007c7c)
/* ---- stdintが無い環境用 ---- */
typedef unsigned short uint16_t;
typedef unsigned long  uint32_t;

#define SPK (PE.DR.BIT.B0)
typedef struct {
    uint16_t frequency;
    uint16_t duration;
} NOTE;

/* 単音バトルメロディ（ロング・ループ対応） */
const NOTE tone_array[] = {
    { 277, 250 },
    { 233, 250 },
    { 175, 250 },
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    { 440, 666 },
};


int make1s = 0;
int timing_frag = 0;
int tone_count = sizeof(tone_array) / sizeof(tone_array[0]) - 1;
int j = 0;
#pragma interrupt INT_CMT1_CMI0
void INT_CMT1_CMI0()
{
}
#pragma interrupt INT_MTU2_CMI1
void INT_MTU2_CMI1()
{
	MTU21.TSR.BIT.TGFA = 0;		// 割り込み要求をクリア

	SPK ^= 1;
}
#pragma interrupt INT_MTU23_CMI2
void INT_MTU23_CMI2()
{
	MTU23.TSR.BIT.TGFA = 0;		// 割り込み要求をクリア

    // MTU2.TSTR.BIT.CST1 ^= 1;       // MTU2 CH1スタート
    // printf(".");
    make1s++;
    if(make1s >= 10){
        make1s = 0;
        timing_frag = 1;
        // printf(".");
        MTU2.TSTR.BIT.CST3 = 0;  // タイマー停止
    }
}
int freq = 0,dur = 0;
void init_MTU2(){
    
    STB.CR4.BIT._MTU2 = 0;

    //MTU2 ch1
    MTU21.TCR.BIT.TPSC = 3;  // 1/64選択
    MTU21.TCR.BIT.CCLR = 1;  // TGRAのコンペアマッチでクリア
    MTU21.TGRA = 3125/20 - 1;  // 20kHz
    MTU21.TIER.BIT.TGIEA = 1; // TGFAビットによる割り込み要求を許可
    INTC.IPRD.BIT._MTU21G = 10;	// 割り込み優先レベル = 10
    //MTU2 ch3
    MTU23.TCR.BIT.TPSC = 3;  // 1/64選択
    MTU23.TCR.BIT.CCLR = 1;  // TGRAのコンペアマッチでクリア
    MTU23.TGRA = 2 - 1;
    MTU23.TIER.BIT.TGIEA = 1; // TGFAビットによる割り込み要求を許可
    INTC.IPRE.BIT._MTU23G = 11;	// 割り込み優先レベル = 9
    set_imask(7);			// マスクビット = 7
}

int main(void)
{
    /* ---- ピン設定 ---- */
    PFC.PEIORL.BIT.B0 = 1;
    init_MTU2(); //MUSIC
    MTU2.TSTR.BIT.CST1 = 1;       // MTU2 CH1スタート
    MTU2.TSTR.BIT.CST3 = 1;       // MTU2 CH3スタート

    while (1) {
        if(timing_frag){
                timing_frag = 0;
            j++;
            if(j > tone_count) {
                j = 0;
            }
            MTU2.TSTR.BIT.CST1 = 0;  // タイマー停止
            printf("playing Note freq:%4d,dur:%4d ms,", tone_array[j].frequency, tone_array[j].duration);
            freq = tone_array[j].frequency;
            dur = tone_array[j].duration;
            if (freq > 0) {
                // 音を再生する
                // MTU21のタイマー設定で周波数を制御
                uint16_t timer_count = (31250 / (freq ))*5 - 1 ;
                if (timer_count > 0) {
                    MTU21.TGRA = timer_count;
                    MTU21.TCNT = 0;  // カウンタクリア
                    printf("timer_count:%d,", timer_count);
                    
                    // 持続時間だけ待機
                    uint32_t wait_count = 31250 / (2000 / dur) - 1;
                    wait_count = wait_count > 65535 ? 65535:wait_count;
                    MTU23.TGRA = wait_count;
                    MTU23.TCNT = 0;  // カウンタクリア
                    MTU2.TSTR.BIT.CST1 = 1;  // タイマー開始
                    MTU2.TSTR.BIT.CST3 = 1;  // タイマー開始
                    printf("wait_count:%d\n", wait_count);
                }
            } else {
                // 無音期間
                printf("no note during: %d ms\n",dur);
                uint32_t wait_count = 31250 / (2000 / dur) - 1;
                    wait_count = wait_count > 65535 ? 65535:wait_count;
                MTU23.TGRA = wait_count;
                MTU2.TSTR.BIT.CST3 = 1;  // タイマー開始
            }
            
    }
}
}